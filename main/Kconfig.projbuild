## main/Kconfig.projbuild
```kconfig
menu "Example Configuration"

    config STORE_HISTORY
        bool "Store command history in flash"
        default y
        help
            Linenoise line editing library provides functions to save and load
            command history. If this option is enabled, initalizes a FAT filesystem
            and uses it to store command history.

endmenu

menu "Ethernet Downlink"

    choice ETH_DOWNLINK_TYPE
        prompt "Ethernet downlink driver"
        default ETH_DOWNLINK_EMAC
        config ETH_DOWNLINK_EMAC
            bool "Internal EMAC (WT32-ETH01 / LAN8720)"
        config ETH_DOWNLINK_W5500
            bool "SPI Ethernet W5500"
    endchoice

    # --- Internal EMAC options (WT32-ETH01) ---

    config ETH_MDC_GPIO
        int "ETH MDC GPIO"
        default 23
        depends on ETH_DOWNLINK_EMAC

    config ETH_MDIO_GPIO
        int "ETH MDIO GPIO"
        default 18
        depends on ETH_DOWNLINK_EMAC

    config ETH_PHY_ADDR
        int "ETH PHY address"
        default 1
        depends on ETH_DOWNLINK_EMAC

    config ETH_PHY_POWER_GPIO
        int "ETH PHY power GPIO (-1 for none)"
        default 16
        depends on ETH_DOWNLINK_EMAC

    # --- W5500 SPI Ethernet options ---

    config ETH_SPI_HOST
        int "SPI host number (1=SPI2_HOST, 2=SPI3_HOST)"
        default 1
        depends on ETH_DOWNLINK_W5500

    config ETH_SPI_MISO_GPIO
        int "W5500 MISO GPIO"
        default 5
        depends on ETH_DOWNLINK_W5500

    config ETH_SPI_MOSI_GPIO
        int "W5500 MOSI GPIO"
        default 6
        depends on ETH_DOWNLINK_W5500

    config ETH_SPI_SCLK_GPIO
        int "W5500 SCLK GPIO"
        default 4
        depends on ETH_DOWNLINK_W5500

    config ETH_SPI_CS_GPIO
        int "W5500 CS (SCS) GPIO"
        default 7
        depends on ETH_DOWNLINK_W5500

    config ETH_SPI_INT_GPIO
        int "W5500 INT GPIO"
        default 3
        depends on ETH_DOWNLINK_W5500

    config ETH_SPI_RST_GPIO
        int "W5500 RST GPIO (-1 to disable)"
        default 2
        depends on ETH_DOWNLINK_W5500

    config ETH_SPI_CLOCK_MHZ
        int "W5500 SPI clock speed (MHz)"
        default 10
        range 1 80
        depends on ETH_DOWNLINK_W5500
        help
            Upper bound for SPI clock; the driver rounds DOWN to the nearest
            divider of the 80 MHz APB clock. Achievable values: 80, 40, 26.67,
            20, 16, 13.33, 11.43, 10, ... MHz. Setting e.g. 25 rounds to 20;
            set 27 to land on 26.67. 80 MHz maxes out the W5500 but needs
            clean wiring.

endmenu
```

## sdkconfig.defaults.w5500_c3
```kconfig
# W5500 SPI Ethernet + ESP32-C3 SuperMini
#
# Wiring:
#   W5500 MISO  -> GPIO5   W5500 MOSI  -> GPIO6
#   W5500 SCLK  -> GPIO4   W5500 CS    -> GPIO7
#   W5500 INT   -> GPIO3   W5500 RST   -> GPIO2
#
# Build:
#   idf.py set-target esp32c3 -B build_w5500_c3 \
#     -D SDKCONFIG=sdkconfig.w5500_c3 \
#     -D SDKCONFIG_DEFAULTS="sdkconfig.defaults;sdkconfig.defaults.w5500_c3" \
#     build
#
# Flash/monitor:
#   idf.py -B build_w5500_c3 -p /dev/ttyACM0 flash monitor   # SuperMini (USB-JTAG)
#   idf.py -B build_w5500_c3 -p /dev/ttyUSB0 flash monitor   # DevKit-M-1 (UART)

# Select W5500 downlink driver
CONFIG_ETH_DOWNLINK_W5500=y

# Enable W5500 SPI Ethernet driver in ESP-IDF
CONFIG_ETH_USE_SPI_ETHERNET=y
CONFIG_ETH_SPI_ETHERNET_W5500=y

# W5500 pin assignments
CONFIG_ETH_SPI_HOST=1
CONFIG_ETH_SPI_MISO_GPIO=5
CONFIG_ETH_SPI_MOSI_GPIO=6
CONFIG_ETH_SPI_SCLK_GPIO=4
CONFIG_ETH_SPI_CS_GPIO=7
CONFIG_ETH_SPI_INT_GPIO=3
CONFIG_ETH_SPI_RST_GPIO=2

# SPI clock speed
CONFIG_ETH_SPI_CLOCK_MHZ=25

# Use built-in USB Serial/JTAG as console (SuperMini has no separate UART chip)
CONFIG_ESP_CONSOLE_USB_SERIAL_JTAG=y

# ESP32-C3 max CPU frequency is 160 MHz (no 240 MHz option)
CONFIG_ESP_DEFAULT_CPU_FREQ_MHZ_160=y
# CONFIG_ESP_DEFAULT_CPU_FREQ_MHZ_240 is not set

# W5500 SPI polling starves IDLE task on single-core C3 — don't watch it
CONFIG_ESP_TASK_WDT_CHECK_IDLE_TASK_CPU0=n

# Raise main task priority so the REPL can compete with ETH MAC (priority 18)
# and WiFi tasks on the single-core C3.  Default is 1, which starves the console.
CONFIG_ESP_MAIN_TASK_PRIO=5

# Add RTC FAST memory (~8 KB) to heap to ease DMA SRAM pressure
# (IRAM optimizations and DMA descriptors share the same physical SRAM pool on C3)
CONFIG_ESP_SYSTEM_ALLOW_RTC_FAST_MEM_AS_HEAP=y

# --- Performance: IRAM placement for hot-path code ---
# SPI master: put polling/ISR functions in IRAM (avoids flash cache misses
# during W5500 transfers that compete with WiFi for the cache)
CONFIG_SPI_MASTER_IN_IRAM=y
CONFIG_SPI_MASTER_ISR_IN_IRAM=y

# lwIP: packet processing hot path in IRAM
CONFIG_LWIP_IRAM_OPTIMIZATION=y

# Optimize for speed instead of size (overrides base sdkconfig.defaults)
CONFIG_COMPILER_OPTIMIZATION_PERF=y
# CONFIG_COMPILER_OPTIMIZATION_SIZE is not set

# Additional WiFi library functions in IRAM (~5 KB); IRAM_OPT and RX_IRAM_OPT already default y
#CONFIG_ESP_WIFI_EXTRA_IRAM_OPT=y
```

## sdkconfig.defaults.wt32_eth_sta_uplink
```kconfig
# WT32-ETH01: WiFi STA uplink + Ethernet downlink
# Use with: idf.py -B build_eth_sta -D SDKCONFIG_DEFAULTS="sdkconfig.defaults;sdkconfig.defaults.wt32_eth_sta_uplink" build

# Ethernet downlink GPIOs (WT32-ETH01 with LAN8720)
CONFIG_ETH_MDC_GPIO=23
CONFIG_ETH_MDIO_GPIO=18
CONFIG_ETH_PHY_ADDR=1
CONFIG_ETH_PHY_POWER_GPIO=16

# Ethernet driver
CONFIG_ETH_USE_ESP32_EMAC=y

# ESP32 supports 240 MHz
CONFIG_ESP_DEFAULT_CPU_FREQ_MHZ_240=y

# --- Performance: optimize for speed instead of size ---
CONFIG_COMPILER_OPTIMIZATION_PERF=y
# CONFIG_COMPILER_OPTIMIZATION_SIZE is not set

# lwIP packet processing hot path in IRAM
CONFIG_LWIP_IRAM_OPTIMIZATION=y
```
